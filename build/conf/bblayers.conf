## build/conf/bblayers.conf
```bitbake
POKY_BBLAYERS_CONF_VERSION = "2"

BBPATH = "${TOPDIR}"
BBFILES ?= ""

BBLAYERS ?= " \
  ${TOPDIR}/../poky/meta \
  ${TOPDIR}/../poky/meta-poky \
  ${TOPDIR}/../poky/meta-yocto-bsp \
  ${TOPDIR}/../meta-openembedded/meta-oe \
  ${TOPDIR}/../meta-openembedded/meta-multimedia \
  ${TOPDIR}/../meta-openembedded/meta-networking \
  ${TOPDIR}/../meta-openembedded/meta-python \
  ${TOPDIR}/../meta-raspberrypi \
  ${TOPDIR}/../meta-pitrezor \
  "
```

## build/conf/local.conf
```bitbake
MACHINE ??= "raspberrypi0-wifi"
#MACHINE ??= "raspberrypi4-64"
#MACHINE ??= "raspberrypi0-2w-64"
DISTRO ?= "poky"
PACKAGE_CLASSES ?= "package_rpm"
EXTRA_IMAGE_FEATURES += "read-only-rootfs"
USER_CLASSES ?= "buildstats image-prelink"
PATCHRESOLVE = "noop"
DISTRO_FEATURES:remove = " acl alsa argp bluetooth irda largefile pcmcia usbgadget usbhost xattr nfs zeroconf pci 3g nfc x11 wayland pulseaudio "
IMAGE_FSTYPES = "rpi-sdimg"
VIRTUAL-RUNTIME_init_manager = "sysvinit"
VIRTUAL-RUNTIME_dev_manager = ""
BOOTDD_VOLUME_ID = "boot"
SERIAL_CONSOLES = ""
SYSVINIT_ENABLED_GETTYS = ""
ENABLE_DWC2_PERIPHERAL = "1"
GPU_MEM = "64"
VC4DTBO = "vc4-fkms-v3d"
CMDLINE = "dwc_otg.lpm_enable=0 root=/dev/mmcblk0p2 rootfstype=ext4 rootwait consoleblank=0 ro quiet "
KERNEL_MODULE_AUTOLOAD += " gadgetfs dwc2 vc4 v3d "
EXTRA_IMAGECMD:ext3 = "-i 4096 -L fs"
FATPAYLOAD += " ${datadir}/pitrezor/pitrezor.config"
TOOLCHAIN_TARGET_TASK += " bcm2835-staticdev "
TOOLCHAIN_HOST_TASK:append += " nativesdk-protobuf-compiler nativesdk-python3-protobuf nativesdk-python3-setuptools nativesdk-python3 nativesdk-python3-click nativesdk-python3-trezor nativesdk-python3-mako nativesdk-python3-munch nativesdk-python3-typing-extensions"
RPI_EXTRA_CONFIG = "hdmi_safe=1"

BB_DISKMON_DIRS = "\
    STOPTASKS,${TMPDIR},1G,100K \
    STOPTASKS,${DL_DIR},1G,100K \
    STOPTASKS,${SSTATE_DIR},1G,100K \
    STOPTASKS,/tmp,100M,100K \
    ABORT,${TMPDIR},100M,1K \
    ABORT,${DL_DIR},100M,1K \
    ABORT,${SSTATE_DIR},100M,1K \
    ABORT,/tmp,10M,1K"

CONF_VERSION = "2"
```

## meta-pitrezor/conf/layer.conf
```bitbake
# We have a conf and classes directory, add to BBPATH
BBPATH .= ":${LAYERDIR}"

# We have recipes-* directories, add to BBFILES
BBFILES += "${LAYERDIR}/recipes-*/*/*.bb \
	${LAYERDIR}/recipes-*/*/*.bbappend"

BBFILE_COLLECTIONS += "meta-pitrezor"
BBFILE_PATTERN_meta-pitrezor = "^${LAYERDIR}/"
BBFILE_PRIORITY_meta-pitrezor = "10"

LAYERSERIES_COMPAT_meta-pitrezor = "honister"
```
